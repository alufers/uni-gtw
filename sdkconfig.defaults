## sdkconfig.defaults
```kconfig
# WebSocket support

CONFIG_HTTPD_WS_SUPPORT=y
CONFIG_HTTPD_WS_POST_HANDSHAKE_CB_SUPPORT=y
CONFIG_HTTPD_WS_PRE_HANDSHAKE_CB_SUPPORT=y

# Custom partition table with OTA + LittleFS
CONFIG_PARTITION_TABLE_CUSTOM=y
CONFIG_PARTITION_TABLE_CUSTOM_FILENAME="partitions.csv"

CONFIG_ESPTOOLPY_FLASHSIZE_4MB=y
CONFIG_ESPTOOLPY_FLASHSIZE="4MB"
# Timer daemon task stack — must accommodate config_do_save() + maybe_query_position()
CONFIG_FREERTOS_TIMER_TASK_STACK_DEPTH=4096
# Use USB JTAG as the primary interactive console (REPL)
CONFIG_ESP_CONSOLE_USB_SERIAL_JTAG=y
```
